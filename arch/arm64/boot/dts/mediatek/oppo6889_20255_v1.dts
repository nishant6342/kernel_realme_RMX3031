/*
 * Mediatek's mt6885 SoC device tree source
 *
 * Copyright (C) 2016 MediaTek Inc.
 *
 * This program is free software; you can redistribute it and/or modify
 * it under the terms of the GNU General Public License version 2 as
 * published by the Free Software Foundation.
 *
 * This program is distributed in the hope that it will be useful,
 * but WITHOUT ANY WARRANTY; without even the implied warranty of
 * MERCHANTABILITY or FITNESS FOR A PARTICULAR PURPOSE.
 * See http://www.gnu.org/licenses/gpl-2.0.html for more details.
 */
/dts-v1/;
/plugin/;
#include <dt-bindings/interrupt-controller/irq.h>
#include <dt-bindings/interrupt-controller/arm-gic.h>
#include <dt-bindings/spmi/spmi.h>
#include <dt-bindings/pinctrl/mt6885-pinfunc.h>

#include "mediatek/oppo6889/common/cust_oppo20131_camera.dtsi"
#include "mediatek/oppo6889/common/oppo6889_common.dtsi"

#include "mediatek/oppo6889/20255/common/20255_common.dtsi"
#include "mediatek/oppo6889/20255/pcbv1/20255_cust.dtsi"

#include <oppo6889/cust.dtsi>
/*End of this file, DO NOT ADD ANYTHING HERE*/
