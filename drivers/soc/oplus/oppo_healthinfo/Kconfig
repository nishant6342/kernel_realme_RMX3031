## drivers/soc/oplus/oppo_healthinfo/Kconfig
```kconfig
#ifdef OPLUS_FEATURE_HEALTHINFO
config OPPO_HEALTHINFO
bool "config oppo healthinfo"
help
    define this config to init oppo healthinfo.
config CAMERA_OPT
	bool "config camera opt"
	default n
	help
	  reduce camera provider task runnable time
#endif /* OPLUS_FEATURE_HEALTHINFO */
```

## drivers/soc/oplus/system/oplus_hans/Kconfig
```kconfig
#ifdef OPLUS_FEATURE_HANS_FREEZE
#Kun.Zhou@ANDROID.RESCONTROL, 2019/09/23, add for hans freeze manager
config OPLUS_FEATURE_HANS_GKI
	tristate "HANS kernel and HANS native communication channel"
	default n
	help
	  Key events (signal/network package/binder) report to HAS native.
#endif /*OPLUS_FEATURE_HANS_FREEZE*/
```

## drivers/soc/oppo/oppo_criticallog/Kconfig
```kconfig
#ifdef VENDOR_EDIT
config OPPO_CRITICALLOG
	bool "config oppo critical log"
	default y
	help
            define this config to init oppo critical log driver.
#endif /* VENDOR_EDIT */
```

## mm/oppo_healthinfo/Kconfig
```kconfig
#ifdef OPLUS_FEATURE_HEALTHINFO
config OPPO_MEM_MONITOR
	bool "memory monitor "
	default n
	help
	 memory monitor.
#endif /* OPLUS_FEATURE_HEALTHINFO */
```

## net/oplus_modules/Kconfig
```kconfig
# SPDX-License-Identifier: GPL-2.0-only
# Copyright (C) 2018-2020 Oplus. All rights reserved.

#ShiQianhua@NETWORK.DATA.1816043, 2021/08/09, add for dns hook.
source "net/oplus_modules/oplus_dns_hook/Kconfig"

#ShiQianhua@NETWORK.DATA.2360276, 2021/11/02 add for kernel stats
source "net/oplus_modules/oplus_stats_calc/Kconfig"
```

## sound/soc/codecs/audio/Kconfig
```kconfig
#
# oplus extend audio codec configuration
#

config SIA_PA_ALGO
	bool "Use SIA PA ALGO"
	default n

config SIA_PA_ALGO_MT6833
	bool "Use SIA PA FOR MT6833"
	default n

config SND_SOC_AW87339
	bool "Use AW87339 As PA"
	default n

config HSKEY_BLOCK
	bool "Block hskey for 1s"
	default n
#ifdef OPLUS_ARCH_EXTENDS
config SND_SOC_AW87XXX
        tristate "SoC Audio for awinic AW87XXX Smart K PA"
        depends on I2C
        help
          This option enables support for AW87XXX Smart K PA.

config SND_SOC_AW87XXX_2_X_0
        tristate "SoC Audio for awinic AW87360 Smart K PA-Only For limu"
        depends on I2C
        help
          This option enables support for AW87390 Smart K PA.
config SND_SOC_OPLUS_PA_MANAGER
       bool "add PA manager"
       default n

config SND_SOC_SIA81XX_V1_2_0
	bool "Use SIA PA Driver V1.2.0"
	default n

config SND_SOC_TFA_HAPTIC
	bool "add tfa haptic"
	default n

config SND_SOC_FSA
        bool "add fsa driver"
	default n
#endif /* OPLUS_ARCH_EXTENDS */
```
